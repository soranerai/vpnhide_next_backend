## kpatch/security/vpnhide/Kconfig
```kconfig
config VPNHIDE
	bool "VPNHide Next in-tree support"
	default n
	depends on SECURITY && NET && INET && BPF_SYSCALL
	depends on IPV6
	help
	  Builds the VPNHide Next kernel subsystem. Intercepts sockets, netlink
	  dumps, route queries, and BPF map reads for target UIDs to hide active
	  VPN interfaces. Filesystem path hiding is provided by SUSFS when
	  available and is configured by the userspace daemon.

	  Unlike the out-of-tree kmod version, this implementation patches
	  call sites directly, eliminating kretprobe overhead and enabling
	  early-return optimisations that avoid generating netlink messages
	  that would otherwise be discarded.

	  If unsure, say N.
```
